## Platform/NVIDIA/Jetson/Jetson.defconfig
```kconfig
# SPDX-FileCopyrightText: Copyright (c) 2023-2024 NVIDIA CORPORATION & AFFILIATES. All rights reserved.
#
# SPDX-License-Identifier: BSD-2-Clause-Patent
CONFIG_SOC_XAVIER=n
CONFIG_SOC_ORIN=y
CONFIG_EMMC=y
CONFIG_SDCARD=n
CONFIG_ARM_WATCHDOG=n
CONFIG_BOOT_QUICK_BOOT=y
CONFIG_BOOT_QUICK_BOOT_ENABLED=y
CONFIG_BOOT_NATIVE_ANDROID_PARTITION_SUPPORT=n
CONFIG_BOOT_NVIDIA_CUSTOM_OPTION_DESCRIPTION=n
CONFIG_DEVICETREE=y
CONFIG_UFS=n
CONFIG_SATA=n
CONFIG_NETWORKING_DEVICE_NVIDIA=n
CONFIG_NETWORKING_DEVICE_ASIX=n
CONFIG_NETWORKING_DEVICE_REALTEK=n
CONFIG_FS_EXT4=y
CONFIG_NVIDIA_DISPLAY=y
CONFIG_IPMI_BMC=n
CONFIG_L4T=y
CONFIG_FIRMWARE_MANAGEMENT_DIRECT=n
# CONFIG_FIRMWARE_CAPSULE_SIZE=0xc00000
# CONFIG_FIRMWARE_MANAGEMENT_FMP_ESRT_GUID="7C374309-1649-4682-8BEE-04F3A8399414"
CONFIG_SERIAL_PORT_CONSOLE_TEGRA=y
CONFIG_REAL_TIME_CLOCK_MAXIM=y
CONFIG_SMBIOS_ARM=y
CONFIG_BOOT_ANDROID_FASTBOOT=n
CONFIG_SECURITY_TPM_FIRMWARE=y
CONFIG_SECURITY_MM_OPTEE=y
CONFIG_VARIABLE_NON_SECURE_SUPPORTED=n
CONFIG_SECURITY_UEFI_MENU_USER_AUTH=n
CONFIG_EHCI=y
CONFIG_SECURITY_PHYSICAL_PRESENCE=y
CONFIG_SECURITY_DISABLE_PHYSICAL_PRESENCE_POST_SECUREBOOT=y
# CONFIG_RCM_BOOT is not set

CONFIG_NVIDIA_DISPLAY=y
CONFIG_LOGO=y
CONFIG_NVME=y
CONFIG_SDHCI=y
CONFIG_NVIDIA_SDHCI=y
CONFIG_SCSI=n
CONFIG_FS_FAT=y
CONFIG_NETWORKING=n
CONFIG_BOOT_UI_MENU_DISABLED=y
CONFIG_FIRMWARE_MANAGEMENT=n
CONFIG_SHELL=n
CONFIG_BOOT_DEFAULT_TIMEOUT=2
```

## Platform/NVIDIA/Tegra/DefConfigs/t23x_general.defconfig
```kconfig
# SPDX-FileCopyrightText: Copyright (c) 2023-2025 NVIDIA CORPORATION & AFFILIATES. All rights reserved.
#
# SPDX-License-Identifier: BSD-2-Clause-Patent
CONFIG_SOC_T23X=y
CONFIG_BUILD_GENERAL=y
CONFIG_PLATFORM_GUID="49a79a15-8f69-4be7-a30c-a172f44abce7"
# CONFIG_SECURITY_UEFI_MENU_USER_AUTH is not set
# CONFIG_SDCARD is not set
# CONFIG_UFS is not set
# CONFIG_SATA is not set
# CONFIG_NETWORKING_DEVICE_NVIDIA is not set
# CONFIG_BOOT_NVIDIA_CUSTOM_OPTION_DESCRIPTION is not set
CONFIG_BOOT_UI_MENU_DISABLED=y
CONFIG_L4T_LAUNCHER_QUIET_MODE=y
# CONFIG_FIRMWARE_MANAGEMENT is not set
# CONFIG_NETWORKING is not set
# CONFIG_SHELL is not set
```
